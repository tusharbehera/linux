## Documentation/devicetree/bindings/mfd/bcm590xx.txt
```
-------------------------------
BCM590xx Power Management Units
-------------------------------

Required properties:
- compatible: "brcm,bcm59056"
- reg: I2C slave address
- interrupts: interrupt for the PMU. Generic interrupt client node bindings
  are described in interrupt-controller/interrupts.txt

-----------------------
BCM590xx PMU Regulators
-----------------------

Required properties:
- compatible: "brcm,bcm59056-regs"

Optional properties:
- regulators: This is the list of child nodes that specify the regulator
  initialization data for defined regulators.  Generic regulator bindings
  are described in regulator/regulator.txt.

  The valid regulator-compatible values for BCM59056 are:
	rfldo, camldo1, camldo2, simldo1, simlso2, sdldo, sdxldo,
	mmcldo1, mmcldo2, audldo, micldo, usbldo, vibldo,
	csr, iosr1, iosr2, msr, sdsr1, sdsr2, vsr

Example:
	pmu: bcm59056@8 {
		compatible = "brcm,bcm59056";
		reg = <0x08>;
		interrupts = <GIC_SPI 215 IRQ_TYPE_LEVEL_HIGH>;
		regs {
			compatible = "brcm,bcm59056-regs";
			regulators {
				#address-cells = <1>;
				#size-cells = <0>;

				rfldo_reg: regulator@0 {
					reg = <0>;
					regulator-compatible = "rfldo";
					regulator-min-microvolt = <1200000>;
					regulator-max-microvolt = <3300000>;
				};

				...
			};
		};
	};
```
